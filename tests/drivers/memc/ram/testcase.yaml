## tests/drivers/memc/ram/testcase.yaml
```yaml
tests:
  drivers.memc.stm32_fmc_nor_psram:
    tags:
      - drivers
      - memc
    depends_on: memc
    filter: dt_compat_enabled("st,stm32-fmc-nor-psram")
  drivers.memc.stm32_sdram:
    tags:
      - drivers
      - memc
    depends_on: memc
    filter: dt_compat_enabled("st,stm32-fmc-sdram")
  drivers.memc.smc_sram:
    tags:
      - drivers
      - memc
    depends_on: memc
    filter: dt_compat_enabled("atmel,sam-smc")
    platform_allow: sam4s_xplained
    integration_platforms:
      - sam4s_xplained
  drivers.memc.smc_sram_sam_e70:
    tags:
      - drivers
      - memc
    depends_on: memc
    build_only: true
    filter: dt_compat_enabled("atmel,sam-smc")
    platform_allow: sam_e70_xplained/same70q21b
  drivers.memc.sifive_ddr:
    simulation_exclude:
      - renode
    tags:
      - drivers
      - memc
    platform_allow: hifive_unmatched
```
